## fw/fw0/boards/wdee/SmallKB/Kconfig.SmallKB
```kconfig
# ボードに固有のKconfigオプションを定義するファイルです。
# このファイルは、カスタムボードに特有の設定項目をKconfigシステムに追加したり、
# 選択肢として提供するために使用されます。
# 他のKconfigファイル（prj.confやKconfig.defconfig）で
# 使用できる設定オプションを「作成」します。
# menu "SmallKB board options"
#
# config SMALLKB_CUSTOM_FEATURE
#     bool "Enable custom feature for SmallKB"
#    default n
#     help
#        Enable or disable the custom feature specific to the SmallKB board.

config BOARD_SMALLKB
	select SOC_NRF52832_QFAA
```

## fw/fw0/boards/wdee/SmallKB/Kconfig.defconfig
```kconfig
# 役割
#
#    ボードに固有のデフォルト設定を定義するファイルです。
#    特定のボードをビルドする際に、Kconfigシステムが採用する「デフォルトの値」を指定します。
#    主に、Zephyr全体で使われる一般的なKconfigオプション（例: UART, I2Cなど）に対して、そのボードに適したデフォルト値を提供します。




if BOARD_SMALLKB

config BT_CTLR
	default BT

config LOG_BACKEND_RTT_BUFFER
	default 0
config LOG_BACKEND_RTT_OUTPUT_DEFAULT
	default LOG_BACKEND_RTT_BUFFER

config SEGGER_RTT_BUFFER_SIZE_UP
	default 1024
config SEGGER_RTT_BUFFER_SIZE_DOWN
	default 16

endif # BOARD_SMALLKB
```

## fw/fw0/boards/wdee/SmallKB/SmallKB_defconfig
```kconfig
# 3. SmallKB_defconfig
#
#（board_name_defconfig）
#役割
#
#    このファイルは、ビルド時に生成される.configファイルのテンプレートとして機能します。
#    カスタムボードのビルド設定全体をまとめるために使用され、Kconfig.defconfigと連携して動作します。


CONFIG_ARM_MPU=y
CONFIG_HW_STACK_PROTECTION=y
CONFIG_PM_DEVICE=y
CONFIG_GPIO=y

CONFIG_USE_SEGGER_RTT=y
CONFIG_UART_CONSOLE=n
CONFIG_LOG_BACKEND_RTT=y
CONFIG_LOG=y

CONFIG_BT=y
CONFIG_BT_HCI=y
CONFIG_BT_MAX_CONN=2
CONFIG_BT_MAX_PAIRED=2
CONFIG_BT_SMP=y
CONFIG_BT_SMP_SC_PAIR_ONLY=y
CONFIG_BT_ATT_TX_COUNT=5
CONFIG_BT_PERIPHERAL=y
CONFIG_BT_DEVICE_NAME="SmallKB_1_Key_KB"
CONFIG_BT_DEVICE_APPEARANCE=961


CONFIG_BT_BAS=y
CONFIG_BT_HIDS=y
CONFIG_BT_HIDS_MAX_CLIENT_COUNT=2
CONFIG_BT_HIDS_DEFAULT_PERM_RW_ENCRYPT=y
CONFIG_BT_GATT_UUID16_POOL_SIZE=40
CONFIG_BT_GATT_CHRC_POOL_SIZE=20

CONFIG_BT_CONN_CTX=y

CONFIG_BT_DIS=y
CONFIG_BT_DIS_PNP=y
CONFIG_BT_DIS_MANUF="wdee"
CONFIG_BT_DIS_PNP_VID_SRC=2
CONFIG_BT_DIS_PNP_VID=0x1145
CONFIG_BT_DIS_PNP_PID=0x1419
CONFIG_BT_DIS_PNP_VER=0x0100

CONFIG_SYSTEM_WORKQUEUE_STACK_SIZE=2048

CONFIG_SETTINGS=y
CONFIG_NVS=y
CONFIG_BT_SETTINGS=y
CONFIG_BT_KEYS_OVERWRITE_OLDEST=y
CONFIG_FLASH=y
CONFIG_FLASH_PAGE_LAYOUT=y
CONFIG_FLASH_MAP=y

CONFIG_DK_LIBRARY=y
```
